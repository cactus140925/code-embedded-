#include <Wire.h>
#include <Adafruit_GFX.h>
#include <Adafruit_SSD1306.h>
#include <ESP8266WiFi.h>       
#include <NTPClient.h>
#include <WiFiUdp.h>
#include <ESP8266HTTPClient.h> 
#include <WiFiClient.h>
#include <ArduinoJson.h>
#include <time.h> 
#include <EEPROM.h> 

// --- CẤU HÌNH WIFI ---
const char* ssid     = "Nha co rat nhieu cay 2020";
const char* password = "phuongthaoquan@@";

// --- CẤU HÌNH THỜI TIẾT ---
String latitude = "21.02"; 
String longitude = "105.85";
String weatherURL = "http://api.open-meteo.com/v1/forecast?latitude=" + latitude + "&longitude=" + longitude + "&current=temperature_2m,weather_code";

// --- CẤU HÌNH MÀN HÌNH & NÚT NHẤN ---
#define SCREEN_WIDTH 128
#define SCREEN_HEIGHT 64
#define OLED_RESET -1

#define SDA_PIN 4 
#define SCL_PIN 5

#define BTN_SET  14  
#define BTN_UP   12  
#define BTN_DOWN 13  
#define BUZZ 15      

Adafruit_SSD1306 display(SCREEN_WIDTH, SCREEN_HEIGHT, &Wire, OLED_RESET);

// --- NTP Client ---
WiFiUDP ntpUDP;
NTPClient timeClient(ntpUDP, "pool.ntp.org", 25200, 60000);

// --- BIẾN TOÀN CỤC ---
float currentTemp = 0.0;
int currentWeatherCode = 0; 
unsigned long lastUpdateEpoch = 0; 
const long updateInterval = 3600000; 
bool isWifiConnected = false;

// --- BIẾN WIFI RECONNECT ---
unsigned long lastWifiCheck = 0;
const long wifiCheckInterval = 30000;

// --- BIẾN QUẢN LÝ HIỆU SUẤT ---
unsigned long lastFrameTime = 0; 
const int FRAME_DELAY = 200; 

// --- BIẾN THỜI GIAN THỦ CÔNG ---
long manualTimeOffset = 0; 
int manualSetYear = 2024;
int manualSetMonth = 1;
int manualSetDay = 1;
int manualSetHour = 0;
int manualSetMinute = 0;

// --- BIẾN BÁO THỨC ---
int alarmMonth = 1;   
int alarmDay = 1;     
int alarmHour = 6;    
int alarmMinute = 30; 
bool alarmEnabled = false; 
bool isRinging = false;    
int lastAlarmTriggeredMinute = -1; 

// --- BIẾN SYNC GIỜ ---
bool isSyncingNtp = false;          
unsigned long syncStartTime = 0;    
unsigned long lastSyncAttempt = 0;  

// --- QUẢN LÝ MÀN HÌNH CHỜ & PIN & GALLERY ---
unsigned long lastActivityTime = 0; // Thời điểm cuối cùng có thao tác
const unsigned long SCREENSAVER_START_DELAY = 10000; // 10 giây bắt đầu hiện hình chờ
const unsigned long BITMAP_DURATION = 20000; // Mỗi hình hiện 20 giây
// Tổng thời gian trước khi ngủ = 10s chờ + 3 * 20s hình = 70s
const unsigned long TOTAL_SLEEP_DELAY = SCREENSAVER_START_DELAY + (3 * BITMAP_DURATION); 

bool isDisplayOn = true; // Trạng thái màn hình
bool isPowerSaveEnabled = true; // BIẾN MỚI: Quản lý chế độ tiết kiệm pin (True = Có tắt, False = Luôn bật)

int galleryIndex = 0; // Chỉ số hình ảnh đang xem trong chế độ Gallery

enum AppMode {
  MODE_NORMAL,      
  MODE_SET_MONTH,   
  MODE_SET_DAY,     
  MODE_SET_HOUR,    
  MODE_SET_MINUTE,  
  MODE_MAN_YEAR,
  MODE_MAN_MONTH,
  MODE_MAN_DAY,
  MODE_MAN_HOUR,
  MODE_MAN_MINUTE,
  MODE_ALARM_RINGING,
  MODE_GALLERY // Chế độ xem ảnh thủ công
};
AppMode currentMode = MODE_NORMAL;

unsigned long lastDebounceTime = 0;
const unsigned long debounceDelay = 200; 
unsigned long lastToggleTime = 0; 
unsigned long buttonsComboStart = 0; 

// --- BITMAP HÌNH ẢNH ---
// Bitmap 1 (Cactus Scene)
static const unsigned char PROGMEM bitmap1[] = {
 0x00, 0x00, 0x00, 0x00, 0x00, 0x00, 0x00, 0x00, 0x00, 0x00, 0x00, 0x00, 0x00, 0x00, 0x00, 0x00, 
	0x00, 0x00, 0x00, 0x00, 0x00, 0x00, 0x00, 0x00, 0x00, 0x00, 0x00, 0x00, 0x00, 0x00, 0x00, 0x00, 
	0x00, 0x00, 0x00, 0x00, 0x00, 0x00, 0x00, 0x00, 0x00, 0x00, 0x00, 0x00, 0x00, 0x00, 0x00, 0x00, 
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	0x01, 0xc7, 0xff, 0xff, 0xff, 0xff, 0xff, 0xff, 0xff, 0xff, 0xff, 0xff, 0xff, 0xff, 0x80, 0x00
};

// Bitmap 2 (New)
static const unsigned char PROGMEM bitmap2[] = {
  0x00, 0x00, 0x00, 0x00, 0x00, 0x00, 0x00, 0x00, 0x00, 0x00, 0x00, 0x00, 0x00, 0x00, 0x00, 0x00, 
  0x00, 0x00, 0x00, 0x00, 0x00, 0x00, 0x00, 0x00, 0x00, 0x00, 0x00, 0x00, 0x00, 0x00, 0x00, 0x00, 
  0x00, 0x00, 0x00, 0x00, 0x00, 0x00, 0x00, 0x00, 0x00, 0x00, 0x00, 0x00, 0x00, 0x00, 0x00, 0x00, 
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  0x00, 0x00, 0x00, 0x00, 0x00, 0x00, 0x00, 0x00, 0x00, 0x00, 0x00, 0x00, 0x00, 0x00, 0x00, 0x00
};

// Bitmap 3 (New)
static const unsigned char PROGMEM bitmap3[] = {
  0x00, 0x00, 0x00, 0x00, 0x00, 0x00, 0x00, 0x00, 0x00, 0x00, 0x00, 0x00, 0x00, 0x00, 0x00, 0x00, 
	0x00, 0x00, 0x00, 0x00, 0x00, 0x00, 0x00, 0x00, 0x00, 0x00, 0x00, 0x00, 0x00, 0x00, 0x00, 0x00, 
	0x00, 0x00, 0x00, 0x00, 0x00, 0x00, 0x00, 0x00, 0x00, 0x00, 0x00, 0x00, 0x00, 0x00, 0x00, 0x00, 
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	0x00, 0x00, 0x00, 0x00, 0x00, 0x00, 0x00, 0x00, 0x00, 0x00, 0x00, 0x00, 0x00, 0x00, 0x00, 0x00
};

// Mảng chứa các bitmap để dễ quản lý
const unsigned char* bitmapArray[] = {bitmap1, bitmap2, bitmap3};
const int bitmapCount = 3;


static const unsigned char PROGMEM cactus_32x32[] = {
   0x00, 0x00, 0x00, 0x00, 0x00, 0x00, 0x00, 0x00, 0x00, 0x00, 0x00, 0x00, 0x00, 0x00, 0x00, 0x00,
  0x00, 0x00, 0x00, 0x00, 0x00, 0x03, 0xc0, 0x00, 0x00, 0x03, 0xc0, 0x00, 0x00, 0x07, 0xe0, 0x00,
  0x00, 0x86, 0xe0, 0x00, 0x03, 0xe7, 0xe0, 0x00, 0x03, 0xe7, 0xe0, 0x00, 0x03, 0x67, 0xe1, 0x00,
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  0x00, 0x00, 0x00, 0x00, 0x00, 0x00, 0x00, 0x00, 0x00, 0x00, 0x00, 0x00, 0x00, 0x00, 0x00, 0x00
};

static const unsigned char PROGMEM sun_icon[] = {
  0x00, 0x00, 0x00, 0x00, 0x00, 0x01, 0x80, 0x00, 0x00, 0x01, 0x80, 0x00, 0x00, 0x01, 0x80, 0x00, 
  0x00, 0x00, 0x00, 0x00, 0x01, 0x03, 0xc0, 0x80, 0x00, 0x07, 0xe0, 0x00, 0x00, 0x1f, 0xf8, 0x00, 
  0x00, 0x3f, 0xfc, 0x00, 0x00, 0x7f, 0xfe, 0x00, 0x0c, 0x7f, 0xfe, 0x30, 0x0c, 0xff, 0xff, 0x30, 
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  0x00, 0x01, 0x80, 0x00, 0x00, 0x00, 0x00, 0x00, 0x00, 0x00, 0x00, 0x00, 0x00, 0x00, 0x00, 0x00
};

static const unsigned char PROGMEM moon_icon[] = {
  0x00, 0x00, 0x00, 0x00, 0x00, 0x00, 0x00, 0x00, 0x00, 0x00, 0x00, 0x00, 0x00, 0x03, 0xe0, 0x00, 
  0x00, 0x07, 0xf8, 0x00, 0x00, 0x1e, 0xe0, 0x00, 0x00, 0x7f, 0x80, 0x00, 0x00, 0xff, 0x80, 0x00, 
  0x01, 0xf7, 0x00, 0x00, 0x01, 0xbe, 0x00, 0x00, 0x03, 0xfe, 0x00, 0x00, 0x07, 0xec, 0x00, 0x00, 
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  0x00, 0x03, 0xe0, 0x00, 0x00, 0x00, 0x00, 0x00, 0x00, 0x00, 0x00, 0x00, 0x00, 0x00, 0x00, 0x00
};

static const unsigned char PROGMEM cloud_icon[] = {
 0x00, 0x00, 0x00, 0x00, 0x00, 0x00, 0x00, 0x00, 0x00, 0x00, 0x00, 0x00, 0x00, 0x00, 0x00, 0x00, 
  0x00, 0x0f, 0x80, 0x00, 0x00, 0x1f, 0xc0, 0x00, 0x00, 0x3f, 0xe0, 0x00, 0x00, 0x3f, 0xe1, 0xc0, 
  0x00, 0x3f, 0xf3, 0xe0, 0x00, 0x3f, 0xff, 0xf0, 0x0f, 0xff, 0xff, 0xf8, 0x0f, 0xff, 0xff, 0xf8, 
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  0x00, 0x00, 0x00, 0x00, 0x00, 0x00, 0x00, 0x00, 0x00, 0x00, 0x00, 0x00, 0x00, 0x00, 0x00, 0x00
};

static const unsigned char PROGMEM rain_icon[] = {
 0x00, 0x00, 0x00, 0x00, 0x00, 0x00, 0x00, 0x00, 0x00, 0x00, 0x00, 0x00, 0x00, 0x00, 0x00, 0x00, 
  0x00, 0x00, 0x00, 0x00, 0x00, 0x00, 0x00, 0x00, 0x00, 0x0f, 0x80, 0x00, 0x00, 0x3f, 0xc0, 0x00, 
  0x00, 0x7f, 0xe0, 0x00, 0x00, 0x7f, 0xfc, 0x00, 0x01, 0xff, 0xff, 0x00, 0x03, 0xff, 0xff, 0x00, 
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  0x00, 0x00, 0x00, 0x00, 0x00, 0x00, 0x00, 0x00, 0x00, 0x00, 0x00, 0x00, 0x00, 0x00, 0x00, 0x00
};
void drawHand(int centerX, int centerY, float angleDeg, int length) {
  float rad = angleDeg * 3.14159 / 180;
  int x = centerX + length * sin(rad);
  int y = centerY - length * cos(rad);
  display.drawLine(centerX, centerY, x, y, SSD1306_WHITE);
}

// Hàm cập nhật thời tiết từ Wifi
void fetchWeatherData() {
    WiFiClient client;
    HTTPClient http;
    http.begin(client, weatherURL); 
    int httpCode = http.GET();
    if (httpCode > 0) {
      String payload = http.getString();
      JsonDocument doc; 
      DeserializationError error = deserializeJson(doc, payload);
      if (!error) {
        currentTemp = doc["current"]["temperature_2m"];
        currentWeatherCode = doc["current"]["weather_code"];
      }
    }
    http.end();
}

// Hàm cập nhật dữ liệu tổng quát
void updateDataFromWifi() {
  if (WiFi.status() == WL_CONNECTED) {
    if (timeClient.forceUpdate()) {
       if (timeClient.getEpochTime() > 1600000000) {
          manualTimeOffset = 0; 
       }
    }
    fetchWeatherData();
    lastUpdateEpoch = millis(); 
  }
}

void saveAlarm() {
  EEPROM.write(0, alarmMonth);
  EEPROM.write(1, alarmDay);
  EEPROM.write(2, alarmHour);
  EEPROM.write(3, alarmMinute);
  EEPROM.write(4, alarmEnabled ? 1 : 0);
  EEPROM.commit(); 
}

void loadAlarm() {
  int m = EEPROM.read(0);
  int d = EEPROM.read(1);
  int h = EEPROM.read(2);
  int min = EEPROM.read(3);
  int en = EEPROM.read(4);

  if (m >= 1 && m <= 12 && d >= 1 && d <= 31 && h >= 0 && h <= 23 && min >= 0 && min <= 59) {
    alarmMonth = m;
    alarmDay = d;
    alarmHour = h;
    alarmMinute = min;
    alarmEnabled = (en == 1);
  }
}

void applyManualTime() {
  struct tm t;
  t.tm_year = manualSetYear - 1900;
  t.tm_mon  = manualSetMonth - 1;
  t.tm_mday = manualSetDay;
  t.tm_hour = manualSetHour;
  t.tm_min  = manualSetMinute;
  t.tm_sec  = 0;
  t.tm_isdst = 0; 

  time_t targetEpoch = mktime(&t); 
  manualTimeOffset = targetEpoch - timeClient.getEpochTime();
}

// --- HÀM PHÁT ÂM THANH BÁO THỨC ---
unsigned long lastBeepTime = 0;
const int melody[] = { 
  784, 1047, 1319, 1047, 784, 0, 
  784, 1047, 1319, 1047, 784, 0,
  0 
};
const int noteDurations[] = { 
  120, 120, 120, 120, 240, 50, 
  120, 120, 120, 120, 240, 50, 
  1000 
};
const int totalNotes = 13;
int currentNote = 0;

void playAlarmMelody() {
  unsigned long currentMillis = millis();
  if (currentMillis - lastBeepTime >= noteDurations[currentNote]) {
    lastBeepTime = currentMillis;
    currentNote++;
    if (currentNote >= totalNotes) currentNote = 0;
    
    int noteFreq = melody[currentNote];
    if (noteFreq > 0) tone(BUZZ, noteFreq);
    else noTone(BUZZ);
  }
}

void drawUpdateScreen() {
    display.clearDisplay();
    display.setTextSize(1);
    display.setCursor(30, 25);
    display.println("UPDATING...");
    display.setCursor(40, 40);
    display.println("WIFI");
    display.display();
}

void handleButtons() {
  bool setPressedRaw = (digitalRead(BTN_SET) == LOW);
  bool upPressedRaw  = (digitalRead(BTN_UP) == LOW);
  bool downPressedRaw= (digitalRead(BTN_DOWN) == LOW);

  // --- LOGIC ĐÁNH THỨC & RESET HẸN GIỜ ---
  if (setPressedRaw || upPressedRaw || downPressedRaw) {
      lastActivityTime = millis(); // Reset thời gian chờ
      
      // Nếu màn hình đang tắt (Sleep Mode), bật lại ngay và thoát luôn (không thực hiện chức năng nút)
      if (!isDisplayOn) {
          display.ssd1306_command(SSD1306_DISPLAYON);
          isDisplayOn = true;
          return; 
      }
  }
  // ----------------------------------------

  if (millis() - lastDebounceTime < debounceDelay) return;

  // Đọc lại trạng thái cho logic xử lý (vì ở trên chỉ là check thô để đánh thức)
  bool setPressed = setPressedRaw;
  bool upPressed  = upPressedRaw;
  bool downPressed= downPressedRaw;

  // 1. TỔ HỢP PHÍM: UP + DOWN (Cài giờ thủ công)
  if (upPressed && downPressed) {
      if (buttonsComboStart == 0) buttonsComboStart = millis(); 
      else if (millis() - buttonsComboStart > 1000) { 
          if (currentMode == MODE_NORMAL) {
              time_t epochTime = timeClient.getEpochTime() + manualTimeOffset;
              struct tm *ptm = gmtime((time_t *)&epochTime);
              manualSetYear = ptm->tm_year + 1900;
              manualSetMonth = ptm->tm_mon + 1;
              manualSetDay = ptm->tm_mday;
              manualSetHour = ptm->tm_hour;
              manualSetMinute = ptm->tm_min;
              currentMode = MODE_MAN_YEAR;
              digitalWrite(BUZZ, HIGH); delay(100); digitalWrite(BUZZ, LOW); 
          }
          buttonsComboStart = 0; 
          lastDebounceTime = millis() + 500; 
      }
      return; 
  } 
  
  // 2. TỔ HỢP PHÍM: UP + SET (Cập nhật Wifi thủ công)
  else if (upPressed && setPressed) {
      if (buttonsComboStart == 0) buttonsComboStart = millis();
      else if (millis() - buttonsComboStart > 1000) {
          if (currentMode == MODE_NORMAL) {
              drawUpdateScreen();
              digitalWrite(BUZZ, HIGH); delay(100); digitalWrite(BUZZ, LOW);
              
              if (WiFi.status() != WL_CONNECTED) {
                  WiFi.reconnect();
                  unsigned long startWait = millis();
                  while(WiFi.status() != WL_CONNECTED && millis() - startWait < 5000) {
                    delay(100);
                  }
              }
              
              display.clearDisplay();
              display.setTextSize(1);
              
              if (WiFi.status() == WL_CONNECTED) {
                  // KÍCH HOẠT CHẾ ĐỘ ĐỒNG BỘ KIÊN TRÌ
                  isSyncingNtp = true;
                  syncStartTime = millis();
                  isWifiConnected = true; 

                  display.setCursor(30, 30);
                  display.println("SYNCING...");
                  display.display();
              } else {
                  display.setCursor(35, 30);
                  display.println("NOT FOUND");
                  display.display();
                  digitalWrite(BUZZ, HIGH); delay(500); digitalWrite(BUZZ, LOW);
                  delay(2000); 
              }
          }
          buttonsComboStart = 0;
          lastDebounceTime = millis() + 500;
      }
      return;
  }
  // 3. TỔ HỢP PHÍM MỚI: DOWN + SET (Vào chế độ xem ảnh - Gallery)
  else if (downPressed && setPressed) {
      if (buttonsComboStart == 0) buttonsComboStart = millis();
      else if (millis() - buttonsComboStart > 1000) { // Giữ 1 giây
          if (currentMode == MODE_NORMAL) {
              currentMode = MODE_GALLERY;
              galleryIndex = 0; // Reset về hình đầu tiên
              digitalWrite(BUZZ, HIGH); delay(100); digitalWrite(BUZZ, LOW);
              if (!isDisplayOn) { display.ssd1306_command(SSD1306_DISPLAYON); isDisplayOn = true; }
          }
          buttonsComboStart = 0;
          lastDebounceTime = millis() + 500;
      }
      return;
  }
  else {
      buttonsComboStart = 0; 
  }

  if (!setPressed && !upPressed && !downPressed) return;

  lastDebounceTime = millis();

  if (currentMode == MODE_ALARM_RINGING) {
      isRinging = false;
      currentMode = MODE_NORMAL;
      noTone(BUZZ); 
      currentNote = 0;
      return;
  }

  if (setPressed) {
    switch (currentMode) {
      case MODE_NORMAL:      currentMode = MODE_SET_MONTH; break; 
      case MODE_SET_MONTH:   currentMode = MODE_SET_DAY;   break; 
      case MODE_SET_DAY:     currentMode = MODE_SET_HOUR;  break; 
      case MODE_SET_HOUR:    currentMode = MODE_SET_MINUTE;break; 
      case MODE_SET_MINUTE:  
        currentMode = MODE_NORMAL; 
        if (alarmHour == 0 && alarmMinute == 0) alarmEnabled = false;
        else alarmEnabled = true; 
        saveAlarm();
        break;

      case MODE_MAN_YEAR:    currentMode = MODE_MAN_MONTH; break;
      case MODE_MAN_MONTH:   currentMode = MODE_MAN_DAY;   break;
      case MODE_MAN_DAY:     currentMode = MODE_MAN_HOUR;  break;
      case MODE_MAN_HOUR:    currentMode = MODE_MAN_MINUTE;break;
      case MODE_MAN_MINUTE:
        applyManualTime(); 
        currentMode = MODE_NORMAL;
        break;
      
      case MODE_GALLERY:
        currentMode = MODE_NORMAL; // Thoát chế độ xem ảnh
        break;
    }
  }

  if (upPressed && !downPressed) { 
    switch (currentMode) {
        case MODE_NORMAL:
            // Toggle Power Save
            isPowerSaveEnabled = !isPowerSaveEnabled;
            // Visual feedback
            display.clearDisplay();
            display.setTextSize(1);
            display.setCursor(10, 30);
            if(isPowerSaveEnabled) display.print("TIET KIEM PIN: ON");
            else display.print("MAN HINH: LUON BAT");
            display.display();
            digitalWrite(BUZZ, HIGH); delay(100); digitalWrite(BUZZ, LOW);
            delay(1000); // Pause to let user read
            lastActivityTime = millis(); // Reset timer
            break;

        case MODE_SET_MONTH: alarmMonth++; if (alarmMonth > 12) alarmMonth = 1; break;
        case MODE_SET_DAY:   alarmDay++; if (alarmDay > 31) alarmDay = 1; break;
        case MODE_SET_HOUR:  alarmHour++; if (alarmHour > 23) alarmHour = 0; break;
        case MODE_SET_MINUTE:alarmMinute++; if (alarmMinute > 59) alarmMinute = 0; break;
        
        case MODE_MAN_YEAR:  manualSetYear++; break;
        case MODE_MAN_MONTH: manualSetMonth++; if (manualSetMonth > 12) manualSetMonth = 1; break;
        case MODE_MAN_DAY:   manualSetDay++; if (manualSetDay > 31) manualSetDay = 1; break;
        case MODE_MAN_HOUR:  manualSetHour++; if (manualSetHour > 23) manualSetHour = 0; break;
        case MODE_MAN_MINUTE:manualSetMinute++; if (manualSetMinute > 59) manualSetMinute = 0; break;

        case MODE_GALLERY:
          galleryIndex++;
          if (galleryIndex >= bitmapCount) galleryIndex = 0;
          break;
    }
  }

  if (downPressed && !upPressed) {
    switch (currentMode) {
        case MODE_SET_MONTH: alarmMonth--; if (alarmMonth < 1) alarmMonth = 12; break;
        case MODE_SET_DAY:   alarmDay--; if (alarmDay < 1) alarmDay = 31; break;
        case MODE_SET_HOUR:  alarmHour--; if (alarmHour < 0) alarmHour = 23; break;
        case MODE_SET_MINUTE:alarmMinute--; if (alarmMinute < 0) alarmMinute = 59; break;

        case MODE_MAN_YEAR:  manualSetYear--; break;
        case MODE_MAN_MONTH: manualSetMonth--; if (manualSetMonth < 1) manualSetMonth = 12; break;
        case MODE_MAN_DAY:   manualSetDay--; if (manualSetDay < 1) manualSetDay = 31; break;
        case MODE_MAN_HOUR:  manualSetHour--; if (manualSetHour < 0) manualSetHour = 23; break;
        case MODE_MAN_MINUTE:manualSetMinute--; if (manualSetMinute < 0) manualSetMinute = 59; break;

        case MODE_NORMAL:
           if (millis() - lastToggleTime > 500) {
               alarmEnabled = !alarmEnabled; 
               saveAlarm(); 
               digitalWrite(BUZZ, HIGH); delay(50); digitalWrite(BUZZ, LOW);
               lastToggleTime = millis();
           }
           break;
        
        case MODE_GALLERY:
          galleryIndex--;
          if (galleryIndex < 0) galleryIndex = bitmapCount - 1;
          break;
    }
  }
}

void drawScreen(int h, int m, int s, int currentDay, int currentMonth) {
  display.clearDisplay();

  if (currentMode == MODE_ALARM_RINGING) {
    if ((millis() / 500) % 2 == 0) display.invertDisplay(true);
    else display.invertDisplay(false);

    display.setTextSize(2);
    display.setCursor(10, 10); display.println("BAO THUC!");
    display.setTextSize(1);
    display.setCursor(15, 35); display.print("Ngay "); display.print(alarmDay); display.print("/"); display.println(alarmMonth);
    display.setCursor(30, 50); display.println("Bam de tat");
  } 
  
  else if (currentMode >= MODE_SET_MONTH && currentMode <= MODE_SET_MINUTE) {
    display.invertDisplay(false);
    display.setTextSize(1);
    display.setCursor(16, 0); display.println("CAI DAT BAO THUC");
    
    display.setTextSize(2);
    display.setCursor(34, 12);
    if (alarmDay < 10) display.print("0"); display.print(alarmDay); 
    display.print("/");
    if (alarmMonth < 10) display.print("0"); display.print(alarmMonth); 
    
    display.setCursor(34, 38);
    if (alarmHour < 10) display.print("0"); display.print(alarmHour); 
    display.print(":");
    if (alarmMinute < 10) display.print("0"); display.print(alarmMinute);

    display.setTextSize(1);
    if (currentMode == MODE_SET_DAY)    { display.setCursor(34, 28); display.print("^^"); }
    else if (currentMode == MODE_SET_MONTH) { display.setCursor(70, 28); display.print("^^"); }
    else if (currentMode == MODE_SET_HOUR)  { display.setCursor(34, 54); display.print("^^"); }
    else if (currentMode == MODE_SET_MINUTE){ display.setCursor(70, 54); display.print("^^"); }
  } 

  else if (currentMode >= MODE_MAN_YEAR && currentMode <= MODE_MAN_MINUTE) {
    display.invertDisplay(false);
    display.setTextSize(1);
    display.setCursor(20, 0); display.println("CHINH GIO TAY");

    display.setCursor(40, 10);
    display.print("NAM: "); display.print(manualSetYear);

    display.setCursor(10, 25);
    if (manualSetDay < 10) display.print("0"); display.print(manualSetDay); 
    display.print("/");
    if (manualSetMonth < 10) display.print("0"); display.print(manualSetMonth); 

    display.setTextSize(2);
    display.setCursor(50, 25);
    if (manualSetHour < 10) display.print("0"); display.print(manualSetHour); 
    display.print(":");
    if (manualSetMinute < 10) display.print("0"); display.print(manualSetMinute);

    display.setTextSize(1);
    if (currentMode == MODE_MAN_YEAR)       { display.setCursor(80, 18); display.print("^"); }
    else if (currentMode == MODE_MAN_DAY)   { display.setCursor(10, 35); display.print("^^"); }
    else if (currentMode == MODE_MAN_MONTH) { display.setCursor(28, 35); display.print("^^"); }
    else if (currentMode == MODE_MAN_HOUR)  { display.setCursor(50, 42); display.print("^^"); }
    else if (currentMode == MODE_MAN_MINUTE){ display.setCursor(86, 42); display.print("^^"); }
  }
  
  else {
    display.invertDisplay(false);
    digitalWrite(BUZZ,LOW);

    display.drawBitmap(5, 20, cactus_32x32, 32, 32, SSD1306_WHITE);

    bool isNight = (h >= 18 || h < 6);

    if (isWifiConnected) {
        if (currentWeatherCode <= 1) { 
            if (isNight) display.drawBitmap(40, 20, moon_icon, 32, 32, SSD1306_WHITE);
            else display.drawBitmap(40, 20, sun_icon, 32, 32, SSD1306_WHITE);
        } else if (currentWeatherCode >= 50) display.drawBitmap(40, 20, rain_icon, 32, 32, SSD1306_WHITE);
        else display.drawBitmap(40, 20, cloud_icon, 32, 32, SSD1306_WHITE);
    } else {
        if (isNight) display.drawBitmap(40, 20, moon_icon, 32, 32, SSD1306_WHITE);
        else display.drawBitmap(40, 20, sun_icon, 32, 32, SSD1306_WHITE);
    }

    int cx = 96; int cy = 30; int radius = 26; 
    display.drawCircle(cx, cy, radius, SSD1306_WHITE);
    display.fillCircle(cx, cy, 2, SSD1306_WHITE);

    for (int i = 0; i < 12; i++) {
      float angle = i * 30; float rad = angle * 3.14159 / 180;
      int x1 = cx + 22 * sin(rad); int y1 = cy - 22 * cos(rad);
      int x2 = cx + 26 * sin(rad); int y2 = cy - 26 * cos(rad);
      display.drawLine(x1, y1, x2, y2, SSD1306_WHITE);
    }

    float secAngle  = s * 6;               
    float minAngle  = m * 6 + s * 0.1;
    float hourAngle = (h % 12) * 30 + m * 0.5;
    drawHand(cx, cy, hourAngle, 12);
    drawHand(cx, cy, minAngle, 18);
    drawHand(cx, cy, secAngle, 22);

    display.setCursor(75, 56); display.setTextSize(1);
    if (isWifiConnected) {
      if(isSyncingNtp) {
         if ((millis() / 500) % 2 == 0) display.print("SYNC...");
      } else {
         display.print(currentTemp, 1); display.cp437(true); display.write(248); 
      }
    } else {
      display.print("Manual"); 
    }

    if (alarmEnabled) {
      display.setCursor(5, 0);
      display.setTextSize(1);
      display.print("Ngay "); display.print(alarmDay); display.print(" !");
    }
  }

  display.display();
}

void setup() {
  Serial.begin(115200);
  EEPROM.begin(512);
  loadAlarm(); 

  pinMode(BTN_SET, INPUT_PULLUP);
  pinMode(BTN_UP, INPUT_PULLUP);
  pinMode(BTN_DOWN, INPUT_PULLUP);
  pinMode(BUZZ,OUTPUT);
  
  Wire.begin(SDA_PIN, SCL_PIN); 
  Wire.setClock(400000L); 

  if(!display.begin(SSD1306_SWITCHCAPVCC, 0x3C)) { 
    for(;;);
  }
  display.clearDisplay();
  display.setTextColor(SSD1306_WHITE);

  display.setTextSize(1);
  display.setCursor(5, 20);
  display.println("Connecting Wifi...");
  display.setCursor(5, 35);
  display.println(ssid);
  display.display();

  WiFi.begin(ssid, password);
  unsigned long startAttempt = millis();
  
  // Timeout 30s cho Wifi
  while (WiFi.status() != WL_CONNECTED && millis() - startAttempt < 30000) {
    delay(500);
    display.print(".");
    display.display();
  }

  if (WiFi.status() == WL_CONNECTED) {
    isWifiConnected = true;
    timeClient.begin();
    updateDataFromWifi(); // Lấy dữ liệu lần đầu
  } else {
    isWifiConnected = false;
    timeClient.begin(); 
  }

  // Khởi tạo thời gian hoạt động
  lastActivityTime = millis();
}

void loop() {
  // Check nút bấm (hàm này sẽ reset lastActivityTime nếu có bấm)
  handleButtons(); 

  // --- Cập nhật tự động mỗi 1 giờ (nếu có wifi) ---
  if (isWifiConnected && (millis() - lastUpdateEpoch > updateInterval)) {
      updateDataFromWifi();
  }

  // --- LOGIC KIÊN TRÌ ĐỒNG BỘ GIỜ (PERSISTENT SYNC) ---
  if (isSyncingNtp) {
      if (millis() - lastSyncAttempt > 2000) {
          if (timeClient.forceUpdate()) {
              if (timeClient.getEpochTime() > 1600000000) {
                  manualTimeOffset = 0; 
                  isSyncingNtp = false; 
                  fetchWeatherData();
                  digitalWrite(BUZZ, HIGH); delay(100); digitalWrite(BUZZ, LOW);
                  delay(100);
                  digitalWrite(BUZZ, HIGH); delay(100); digitalWrite(BUZZ, LOW);
              }
          }
          lastSyncAttempt = millis();
      }
      if (millis() - syncStartTime > 300000) {
          isSyncingNtp = false;
          digitalWrite(BUZZ, HIGH); delay(500); digitalWrite(BUZZ, LOW);
      }
  } 
  
  // Tính toán giờ (vẫn chạy ngầm kể cả khi tắt màn hình)
  time_t epochTime = timeClient.getEpochTime() + manualTimeOffset;
  struct tm *ptm = gmtime((time_t *)&epochTime);
  
  int h = ptm->tm_hour;
  int m = ptm->tm_min;
  int s = ptm->tm_sec;
  int currentDay = ptm->tm_mday;
  int currentMonth = ptm->tm_mon + 1;
    
  if (currentMode == MODE_NORMAL && alarmEnabled && !isRinging && 
      h == alarmHour && m == alarmMinute &&
      currentDay == alarmDay && currentMonth == alarmMonth &&
      m != lastAlarmTriggeredMinute) { 
    
    // Nếu có báo thức, bật màn hình ngay lập tức bất kể chế độ ngủ
    if (!isDisplayOn) {
         display.ssd1306_command(SSD1306_DISPLAYON);
         isDisplayOn = true;
    }
    lastActivityTime = millis(); // Reset timer để không bị ngủ lại ngay

    currentMode = MODE_ALARM_RINGING;
    isRinging = true;
    lastAlarmTriggeredMinute = m; 
  }
  
  if (currentMode == MODE_ALARM_RINGING) {
      playAlarmMelody();
  }
  
  if (m != alarmMinute) {
    lastAlarmTriggeredMinute = -1;
  }

  // --- LOGIC HIỂN THỊ VÀ MÀN HÌNH CHỜ ---
  unsigned long idleTime = millis() - lastActivityTime;

  // Nếu đang ở chế độ báo thức hoặc xem ảnh thủ công thì không vào screensaver
  if (currentMode == MODE_ALARM_RINGING || currentMode == MODE_GALLERY) {
      if (!isDisplayOn) {
          display.ssd1306_command(SSD1306_DISPLAYON);
          isDisplayOn = true;
      }
      if (millis() - lastFrameTime > FRAME_DELAY) {
          if (currentMode == MODE_ALARM_RINGING) {
              drawScreen(h, m, s, currentDay, currentMonth);
          } else {
              // Vẽ màn hình Gallery
              display.clearDisplay();
              display.drawBitmap(0, 0, bitmapArray[galleryIndex], 128, 64, SSD1306_WHITE);
              display.display();
          }
          lastFrameTime = millis();
      }
  }
  // Logic Sleep (chỉ kích hoạt nếu chế độ Tiết kiệm Pin được bật)
  else if (isPowerSaveEnabled && idleTime > TOTAL_SLEEP_DELAY) {
      // > 70s -> Tắt màn hình (Ngủ)
      if (isDisplayOn) {
          display.ssd1306_command(SSD1306_DISPLAYOFF);
          isDisplayOn = false;
      }
  }
  // Logic Screensaver (chỉ kích hoạt nếu chế độ Tiết kiệm Pin được bật)
  else if (isPowerSaveEnabled && idleTime > SCREENSAVER_START_DELAY) {
      // Chế độ Màn hình chờ (từ 10s đến 70s)
      if (!isDisplayOn) {
          display.ssd1306_command(SSD1306_DISPLAYON);
          isDisplayOn = true;
      }
      
      // Xác định hình ảnh nào cần hiển thị dựa trên thời gian chờ
      int ssIndex = 0;
      // Nếu > 10s + 20s + 20s = 50s -> Hình 3 (index 2)
      if (idleTime > SCREENSAVER_START_DELAY + 2 * BITMAP_DURATION) {
        ssIndex = 2;
      } 
      // Nếu > 10s + 20s = 30s -> Hình 2 (index 1)
      else if (idleTime > SCREENSAVER_START_DELAY + BITMAP_DURATION) {
        ssIndex = 1;
      } 
      // Nếu > 10s -> Hình 1 (index 0)
      else {
        ssIndex = 0;
      }

      // Vẽ màn hình chờ
      if (millis() - lastFrameTime > FRAME_DELAY) {
          display.clearDisplay();
          display.drawBitmap(0, 0, bitmapArray[ssIndex], 128, 64, SSD1306_WHITE);
          display.display();
          lastFrameTime = millis();
      }
  }
  else {
      // Chế độ bình thường (Hoạt động hoặc Luôn bật) -> Vẽ đồng hồ
      if (!isDisplayOn) {
          display.ssd1306_command(SSD1306_DISPLAYON);
          isDisplayOn = true;
      }
      if (millis() - lastFrameTime > FRAME_DELAY) {
          drawScreen(h, m, s, currentDay, currentMonth);
          lastFrameTime = millis();
      }
  }
}